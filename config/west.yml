## config/west.yml
```yaml
manifest:
  remotes:
    - name: sysless
      url-base: https://github.com/sysless
  projects:
    - name: zmk
      remote: sysless
      revision: main
      import: app/west.yml
  self:
    path: config
```
